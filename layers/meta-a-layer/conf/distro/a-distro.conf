## layers/meta-a-layer/conf/distro/a-distro.conf
```bitbake
require conf/distro/poky.conf

DISTRO = "a-distro"
DISTRO_NAME = "A-Distro (Poky-based)"
DISTRO_VERSION = "1.0"
DISTRO_CODENAME = "whinlatter"

DISTRO_FEATURES:remove = "x11 wayland vulkan opengl"

# wic.bz2: SD bootloader image (flash once)
# tar.gz : rootfs archive to extract into the NFS export
IMAGE_FSTYPES = "wic.bz2 tar.gz"

# Allow passwordless root login (development convenience — do not use in production).
EXTRA_IMAGE_FEATURES += "empty-root-password allow-empty-password allow-root-login serial-autologin-root"

# Raspberry Pi: single bootloader / kernel / dtb, console on UART.
RPI_USE_U_BOOT = "1"
ENABLE_UART = "1"
RPI_KERNEL_DEVICETREE = "broadcom/bcm2711-rpi-4-b.dtb"

# Mini-UART (uart1) needs pinctrl mappings that aren't in the base DT,
# so the kernel's bcm2835-aux-uart driver fails to register without an
# overlay. `dtoverlay=uart1` adds the pinctrl-0/pinctrl-names properties
# the driver needs. This keeps U-Boot/firmware output on the mini-UART
# (where they're hard-coded to print) and gives the kernel a working
# `ttyS0` on the same pins.
RPI_KERNEL_DEVICETREE_OVERLAYS = "overlays/uart1.dtbo"
RPI_EXTRA_CONFIG = "dtoverlay=uart1"

# --- Network boot (TFTP kernel + NFS rootfs) ---
#
# *** REQUIRED ***
# Set the IP of the build host running TFTP + NFS via the shell env var
# `NFS_SERVER_IP` (declared in kas.yml's `env:` section, which flows it
# through to bitbake). For example:
#   export NFS_SERVER_IP=<host-LAN-IP> && uv run kas build kas.yml
# Leaving it unset will produce an unbootable image (the kernel cmdline
# and U-Boot boot script will reference an empty IP).
NFS_SERVER_IP ?= ""

# NFS root for the kernel cmdline. The U-Boot script also sets bootargs
# explicitly; this keeps cmdline.txt consistent for the rare case of
# booting without the U-Boot script.
CMDLINE_ROOT_FSTYPE = ""
CMDLINE_ROOT_PARTITION = "/dev/nfs"
CMDLINE_ROOTFS = "root=/dev/nfs nfsroot=${NFS_SERVER_IP}:/srv/nfs/rpi4,vers=3,nolock,tcp ip=dhcp rw"
```

## layers/meta-a-layer/conf/layer.conf
```bitbake
BBPATH .= ":${LAYERDIR}"

BBFILES += "${LAYERDIR}/recipes-*/*/*.bb \
            ${LAYERDIR}/recipes-*/*/*.bbappend"

BBFILE_COLLECTIONS += "a-layer"
BBFILE_PATTERN_a-layer = "^${LAYERDIR}/"
BBFILE_PRIORITY_a-layer = "10"

LAYERVERSION_a-layer = "1"
LAYERDEPENDS_a-layer = "core raspberrypi"
LAYERSERIES_COMPAT_a-layer = "whinlatter"
```
